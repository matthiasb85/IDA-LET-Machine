 B::

 NAME.RESET
 NAME.SET IP.00 IP.LET_IRQ_C0
 NAME.SET IP.01 IP.LET_100MS_C0
 NAME.SET IP.02 IP.WCET_100MS_C0
 NAME.SET IP.03 IP.LET_20MS_C0
 NAME.SET IP.04 IP.WCET_20MS_C0
 NAME.SET IP.05 IP.LET_10MS_C0
 NAME.SET IP.06 IP.WCET_10MS_C0
 NAME.SET IP.07 IP.LET_IRQ_C1
 NAME.SET IP.08 IP.LET_100MS_C1
 NAME.SET IP.09 IP.WCET_100MS_C1
 NAME.SET IP.10 IP.LET_20MS_C1
 NAME.SET IP.11 IP.WCET_20MS_C1
 NAME.SET IP.12 IP.LET_10MS_C1
 NAME.SET IP.13 IP.WCET_10MS_C1
 NAME.SET IP.14 IP.LET_IRQ_C2
 NAME.SET IP.15 IP.LET_100MS_C2
 NAME.SET IP.CLK IP.WCET_100MS_C2

 ENDDO
