B::

&coreAll SYStem.POLLING SLOW
&coreAll SETUP.URATE 1.s

ENDDO
