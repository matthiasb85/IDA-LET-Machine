B::

SYStem.POLLING SLOW
SETUP.URATE 1.s

ENDDO
